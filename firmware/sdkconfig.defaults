## firmware/sdkconfig.defaults
```kconfig
CONFIG_IDF_TARGET="esp32s3"
CONFIG_ESPTOOLPY_FLASHSIZE_16MB=y
CONFIG_BT_ENABLED=y
CONFIG_BT_NIMBLE_ENABLED=y
CONFIG_BT_NIMBLE_ROLE_CENTRAL=n
CONFIG_BT_NIMBLE_ROLE_PERIPHERAL=y
CONFIG_BT_NIMBLE_MAX_CONNECTIONS=1
CONFIG_BT_CTRL_MODEM_SLEEP=y
CONFIG_BT_CTRL_LPCLK_SEL_MAIN_XTAL=y
CONFIG_PM_ENABLE=y
CONFIG_FREERTOS_USE_TICKLESS_IDLE=y
CONFIG_FATFS_LFN_HEAP=y
CONFIG_SPIRAM=y
CONFIG_SPIRAM_MODE_QUAD=y
CONFIG_SPIRAM_SPEED_80M=y
CONFIG_SPIRAM_MEMTEST=n
CONFIG_SPIRAM_USE_MALLOC=y
CONFIG_ESP_DEFAULT_CPU_FREQ_MHZ_240=y
```

## main/Kconfig.projbuild
```kconfig
menu "UWatch configuration"

config UWATCH_TIMEZONE
    string "Local POSIX timezone"
    default "CET-1CEST-2,M3.5.0/2,M10.5.0/3"
    help
        POSIX TZ string used to convert the UTC hardware clock to local time
        for display, alarms, night mode, and local-date logs. For example,
        use UTC0 for UTC without daylight-saving transitions.

endmenu
```
